## tracker/firmware/main/Kconfig.projbuild
```kconfig
config ENABLE_BMP280
    bool "Enable BMP280 pressure/temperature sensor"
    default y
    help
        Enable BMP280 sensor for pressure, temperature, and altitude readings.
        Disable for Minimal variant to save weight and power.

config ENABLE_GPS
    bool "Enable GPS module (u-blox MAX-M10S or compatible)"
    default n
    help
        Enable GPS via UART1. Uses GPIO1 (RX) and optionally GPIO0 (TX).
        GPS provides latitude, longitude, altitude, and satellite count.
        Must configure GPS to Airborne <1G mode for high-altitude operation.

config GPS_UART_RX_PIN
    int "GPS UART RX pin (receives NMEA from GPS module)"
    default 1
    depends on ENABLE_GPS

config GPS_UART_TX_PIN
    int "GPS UART TX pin (sends config to GPS module, -1 to disable)"
    default -1
    depends on ENABLE_GPS

config GPS_UART_BAUD
    int "GPS UART baud rate"
    default 9600
    depends on ENABLE_GPS

config ENABLE_FEM
    bool "Enable SKY66112 FEM (Power Amplifier + LNA)"
    default n
    help
        Enable SKY66112-11 front-end module for +24 dBm TX and LNA RX.
        Not needed for Minimal variant with wire dipole.

config FEM_TX_PIN
    int "FEM TX_EN GPIO pin"
    default 1
    depends on ENABLE_FEM

config FEM_RX_PIN
    int "FEM RX_EN GPIO pin"
    default 0
    depends on ENABLE_FEM

config ENABLE_ANTENNA_SWITCH
    bool "Enable SP4T antenna switch"
    default n
    help
        Enable SP4T switch for 4-antenna selection (Komfort variant).
        Not needed for Minimal variant with single wire dipole.

config ANTENNA_SWITCH_CTRL1_PIN
    int "SP4T CTRL_1 GPIO pin"
    default 21
    depends on ENABLE_ANTENNA_SWITCH

config ANTENNA_SWITCH_CTRL2_PIN
    int "SP4T CTRL_2 GPIO pin"
    default 20
    depends on ENABLE_ANTENNA_SWITCH

config TX_INTERVAL_SEC
    int "TX interval in seconds"
    default 60
    help
        Seconds between telemetry transmissions. Longer interval = longer flight.

config BENCH_TEST_MODE
    bool "Bench test mode (continuous TX, no deep sleep)"
    default n
    help
        Enable for bench testing: TX telemetry every 10 seconds in a loop
        instead of deep sleep. Ground station can verify continuous reception.
        Disable for flight (uses deep sleep between TX).

config BENCH_TEST_INTERVAL_SEC
    int "Bench test TX interval in seconds"
    default 10
    depends on BENCH_TEST_MODE

config LOW_VOLTAGE_MV
    int "Low voltage threshold in millivolts"
    default 3300
    help
        Skip TX and enter deep sleep immediately if supercap voltage is below
        this threshold. Prevents brownout during low-power conditions.

config RADIO_FREQ_MHZ_X10
    int "Radio frequency in MHz * 10 (e.g. 8680 = 868.0 MHz)"
    default 8680
    help
        LoRa frequency * 10. 8680 for EU ISM (868.0 MHz), 4330 for Sub-GHz (433.0 MHz).

config RADIO_SF
    int "LoRa spreading factor"
    default 9
    help
        SF7 = fast/short range, SF12 = slow/long range. SF9 is a good balance.

config RADIO_TX_POWER_DBM
    int "TX power in dBm"
    default 22
    help
        LR2021 maximum is +22 dBm. With SKY66112 FEM: +24 dBm.

config CALLSIGN_HASH_HEX
    string "Callsign hash as 8-char hex (e.g. 424C4E00)"
    default "424C4E00"
    help
        32-bit identifier for this tracker. Used to distinguish multiple balloons.
        Generate with: python3 -c "print(hex(hash('YOUR_CALLSIGN') & 0xFFFFFFFF))"

config ENABLE_MESH
    bool "Enable mesh networking (fragmentation + erasure coding)"
    default n
    help
        Enable mesh adapter for fragmented, erasure-coded transmissions.
        Uses pipeline (frag + erasure) for reliable delivery over lossy links.

config ENABLE_TDMA
    bool "Enable TDMA scheduler for dual-band operation"
    default n
    depends on ENABLE_MESH
    help
        Enable TDMA time-slot scheduling. Requires GPS PPS for discipline.
        Slots alternate between TX, RX, sleep, and beacon.

config ENABLE_NOSTR_STORE
    bool "Enable Nostr event store (for mesh relay)"
    default n
    depends on ENABLE_MESH
    help
        Enable Nostr event storage for store-and-forward mesh relay.
        Stores up to 512 events with bloom filter deduplication.

config ENABLE_MESHCORE
    bool "Enable MeshCore community mesh (ESP-IDF integration)"
    default n
    help
        Enable MeshCore mesh networking. Runs a continuous mesh loop
        instead of the tracker TX + deep sleep pattern. For bench testing
        and StratoRelay development. Uses same LR2021 radio as tracker.

config MESHCORE_NODE_NAME
    string "MeshCore node name (max 16 chars)"
    default "balloon-01"
    depends on ENABLE_MESHCORE

config BENCH_CONSOLE
    bool "BENCH console firmware (HARM-T4 cross-board sweep console)"
    default n
    help
        Replace the tracker application with the BENCH sweep console defined by
        balloon-e80bench/docs/BENCH-CONSOLE-SPEC.md v1.0: ID?/ROLE/ARM TX/MOD/
        FREQ/PA/START/STOP/SESSION/CONFIG/STAT?/PRBS/QUIET over USB-CDC, with
        25-column PKT lines and PRBS-15 payload verification.

        This is bench hardware only: it takes over app_main() and never flies.
        Build with the bench config, e.g.
          idf.py -DSDKCONFIG=sdkconfig.bench \
                 -DSDKCONFIG_DEFAULTS="sdkconfig.defaults;sdkconfig.bench.defaults" build
        See docs/bench-console-esp32.md.
```
